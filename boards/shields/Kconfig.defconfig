## boards/shields/Kconfig.defconfig
```kconfig
if SHIELD_jericho_LEFT

config ZMK_jericho
    default "jericho"

config ZMK_SPLIT_ROLE_CENTRAL
    default y

endif

if SHIELD_jericho_LEFT || SHIELD_jericho_RIGHT

config ZMK_SPLIT
    default y

endif
```

## boards/shields/jericho/Kconfig.defconfig
```kconfig
if SHIELD_jericho_LEFT

config ZMK_KEYBOARD_NAME
    default "jericho"

config ZMK_SPLIT_ROLE_CENTRAL
    default y

endif

if SHIELD_jericho_LEFT || SHIELD_jericho_RIGHT

config ZMK_SPLIT
    default y

config_BT
    default y

endif
```

## boards/shields/jericho/Kconfig.shield
```kconfig
config SHIELD_jericho_LEFT
    def_bool $(shields_list_contains,jericho_left)

config SHIELD_jericho_RIGHT
    def_bool $(shields_list_contains,jericho_right)
```

## config/boards/shields/Kconfig.shield
```kconfig
# Copyright (c) 2020 Pete Johanson
# SPDX-License-Identifier: MIT

config SHIELD_jericho_LEFT
    def_bool $(shields_list_contains,jericho_left)

config SHIELD_jericho_RIGHT
    def_bool $(shields_list_contains,jericho_right)
```
